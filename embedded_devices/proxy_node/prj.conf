## CMakeLists.txt
```
cmake_minimum_required(VERSION 3.20.0)

find_package(Zephyr REQUIRED HINTS $ENV{ZEPHYR_BASE})
project(proxy_node)

target_sources(app PRIVATE src/main.c)
```

## prj.conf
```kconfig
# CONFIG_LOG_STRDUP_BUF_COUNT=20
# CONFIG_LOG_STRDUP_MAX_STRING=80
CONFIG_BT_DEVICE_NAME="PROXY_NODE"

CONFIG_MAIN_STACK_SIZE=4096
CONFIG_BT_RX_STACK_SIZE=4096
CONFIG_SYSTEM_WORKQUEUE_STACK_SIZE=4096

CONFIG_BT=y
CONFIG_BT_OBSERVER=y
CONFIG_BT_BROADCASTER=y
# CONFIG_BT_DEBUG_LOG=y #ENABLE FOR LOGGING MSGS
CONFIG_BT_MESH_GATT_PROXY=y
CONFIG_BT_PERIPHERAL=y
CONFIG_BT_MESH_PB_GATT=y
CONFIG_BT_MESH_PB_ADV=y

CONFIG_BT_MESH=y
CONFIG_BT_MESH_APP_KEY_COUNT=1
CONFIG_BT_MESH_RELAY=n
CONFIG_BT_MESH_FRIEND=n
CONFIG_BT_MESH_GATT_PROXY=y
CONFIG_BT_MESH_BEACON_ENABLED=y # was n

CONFIG_BT_SETTINGS=y
CONFIG_FLASH=y
CONFIG_FLASH_PAGE_LAYOUT=y
CONFIG_FLASH_MAP=y
CONFIG_FCB=y
CONFIG_SETTINGS=y
CONFIG_SETTINGS_FCB=y

CONFIG_BT_DEBUG_LOG=y #ENABLE FOR LOGGING MSGS
CONFIG_LOG_BUFFER_SIZE=2048
CONFIG_LOG_STRDUP_BUF_COUNT=1
CONFIG_BT_MESH_DEBUG=y #ENABLE FOR LOGGING MSGS
CONFIG_BT_MESH_DEBUG_ACCESS=y
CONFIG_BT_MESH_DEBUG_NET=y

CONFIG_LOG_BACKEND_UART=y
```

## src/main.c
```c
#include <stdlib.h>
#include <bluetooth/bluetooth.h>
#include <bluetooth/hci.h>
#include <settings/settings.h>
#include <drivers/gpio.h>
#include <bluetooth/mesh.h>
#include <random/rand32.h>
#include <bluetooth/conn.h>

#include <zephyr.h>
#include <sys/printk.h>

#include "ble_proxy.h"


void main(void) {

	printk("esp32 start! -- proxy node\n");
	int err = bt_enable(bt_ready);
	if (err) {
		printk("bt_enable failed with err %d", err);
	}

	register_callbacks();

	init_node_data();
	
	// bt_mesh_reset();

	while (1) {
		if (bt_mesh_is_provisioned()) {

		}

		change_data_intermittently();

		printk("bonjourno");
		k_msleep(2000);
	}
}
```
